## board/atmel/sama5d27_som1_ek_custom/Kconfig
```kconfig
if TARGET_SAMA5D27_SOM1_EK_CUSTOM

config SYS_BOARD
	default "sama5d27_som1_ek_custom"

config SYS_VENDOR
	default "atmel"

config SYS_SOC
	default "at91"

config SYS_CONFIG_NAME
	default "sama5d27_som1_ek_custon"

endif
```
